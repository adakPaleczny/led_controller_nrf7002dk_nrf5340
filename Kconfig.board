## Kconfig.board
```kconfig
# Copyright (c) 2023 Nordic Semiconductor ASA
# SPDX-License-Identifier: LicenseRef-Nordic-5-Clause

if SOC_NRF5340_CPUAPP_QKAA

config BOARD_LED_CONTROLLER_NRF7002DK_NRF5340_CPUAPP
	bool "Led Controller nRF7002 DK nRF5340 Application MCU"

config BOARD_LED_CONTROLLER_NRF7002DK_NRF5340_CPUAPP_NS
	bool "Led Controller nRF7002 DK nRF5340 Application MCUnon-secure"

endif # SOC_NRF5340_CPUAPP_QKAA

config BOARD_LED_CONTROLLER_NRF7002DK_NRF5340_CPUNET
	bool "Led Controller nRF7002 DK nRF5340 Network MCU"
	depends on SOC_NRF5340_CPUNET_QKAA
```
